## console-side/sdkconfig.defaults
```kconfig
CONFIG_ESP_CONSOLE_UART_DEFAULT=y
CONFIG_ESPTOOLPY_FLASHSIZE_16MB=y
CONFIG_SPIRAM=n
CONFIG_ESP_MAIN_TASK_STACK_SIZE=8192
CONFIG_FREERTOS_HZ=1000
CONFIG_TINYUSB_HID_COUNT=1
CONFIG_TINYUSB_HID_BUFSIZE=64
```

## portal-side/sdkconfig.defaults
```kconfig
# Console + logs on UART0 (native USB is used as the portal host, shared PHY).
CONFIG_ESP_CONSOLE_UART_DEFAULT=y

# 16 MB flash. PSRAM left OFF: the firmware doesn't need it (internal SRAM is
# plenty for a 1 KB figure image) and octal-PSRAM init crashed on this board.
# To use PSRAM later, enable CONFIG_SPIRAM and the mode that matches the board
# (CONFIG_SPIRAM_MODE_QUAD or _OCT).
CONFIG_ESPTOOLPY_FLASHSIZE_16MB=y
CONFIG_SPIRAM=n

# A little more room for the USB host + portal tasks.
CONFIG_ESP_MAIN_TASK_STACK_SIZE=8192
CONFIG_FREERTOS_HZ=1000

# USB-host enumeration timing. The Portal of Power answers the post-reset
# device-descriptor read too slowly with the defaults, so enumeration fails with
# "ENUM CHECK_SHORT_DEV_DESC FAILED / returned less bytes". Give it much more
# settle time (known ESP-IDF HID-enumeration timing issue).
CONFIG_USB_HOST_DEBOUNCE_DELAY_MS=500
CONFIG_USB_HOST_RESET_HOLD_MS=50
CONFIG_USB_HOST_RESET_RECOVERY_MS=200
CONFIG_USB_HOST_SET_ADDR_RECOVERY_MS=50
```

## v2-tunnel/portal-side/sdkconfig.defaults
```kconfig
CONFIG_ESP_CONSOLE_UART_DEFAULT=y
CONFIG_ESPTOOLPY_FLASHSIZE_16MB=y
CONFIG_SPIRAM=n
CONFIG_ESP_MAIN_TASK_STACK_SIZE=8192
CONFIG_FREERTOS_HZ=1000

# USB-host enumeration timing (same fix as v1).
CONFIG_USB_HOST_DEBOUNCE_DELAY_MS=500
CONFIG_USB_HOST_RESET_HOLD_MS=50
CONFIG_USB_HOST_RESET_RECOVERY_MS=200
CONFIG_USB_HOST_SET_ADDR_RECOVERY_MS=50
```
